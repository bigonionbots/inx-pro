#pragma once

/**
 * @file Resample2x.h
 * @brief 2:1 decimation and 1:2 interpolation for live audio on the module link (game sound).
 *
 * Shared verbatim by both firmwares, like AudioLinkProtocol.h, so keep it dependency-free C++.
 *
 * Game sound is made at 44.1 kHz, sent at 22050 Hz (the link cannot carry more as µ-law) and
 * played at 44.1 kHz. Both steps need a real low-pass: Game Boy square waves are full of
 * harmonics, and averaging pairs / interpolating linearly let them fold back as tones that depend
 * on the note, heard as crackle on some pitches. Measured on uCity's music against the ideal
 * 10 kHz band limit: pair average + linear 12.9 dB SNR, this filter at both ends 27.5 dB.
 *
 * The filter: 63-tap windowed sinc (Blackman), cutoff 10 kHz at 44.1 kHz, Q15, DC gain exactly
 * 1, and the even and odd taps each sum to exactly 1/2 so both interpolator phases have unity
 * gain. Generated by:
 *
 *   h[i] = sinc(2 * fc * (i - 31)) * blackman(i), fc = 10000 / 44100; normalised to sum 1;
 *   q[i] = round(h[i] * 32768), with the rounding remainder added to the centre tap.
 *
 * Sum of |q| is 60268, so an accumulator of 16-bit samples fits in int32.
 */

#include <cstddef>
#include <cstdint>

namespace resample2x {

constexpr size_t TAPS = 63;

inline const int16_t* taps() {
  static const int16_t Q15[TAPS] = {
      0,     0,    -1,    3,     4,    -6,   -14,  8,    32,   -3,   -60,  -17,   95,    64,   -130,  -148,
      148,   278,  -123,  -456,  20,   673,  208,  -912, -630, 1146, 1398, -1344, -3031, 1477, 10276, 14858,
      10276, 1477, -3031, -1344, 1398, 1146, -630, -912, 208,  673,  20,   -456,  -123,  278,  148,   -148,
      -130,  64,   95,    -17,   -60,  -3,   32,   8,    -14,  -6,   4,    3,     -1,    0,    0,
  };
  return Q15;
}

inline int16_t clamp16(const int32_t value) {
  return static_cast<int16_t>(value > 32767 ? 32767 : (value < -32768 ? -32768 : value));
}

/** 44.1 kHz in, 22050 Hz out: push() every input sample; it returns true with an output every other one. */
class Decimator {
 public:
  bool push(const int16_t sample, int16_t& out) {
    history_[pos_] = sample;
    pos_ = (pos_ + 1) % TAPS;
    odd_ = !odd_;
    if (odd_) return false;
    // history_[pos_] is now the oldest sample, which meets the last tap.
    int32_t sum = 0;
    const int16_t* h = taps();
    size_t i = pos_;
    for (size_t k = TAPS; k-- > 0;) {
      sum += static_cast<int32_t>(h[k]) * history_[i];
      i = i + 1 == TAPS ? 0 : i + 1;
    }
    out = clamp16((sum + 16384) >> 15);
    return true;
  }

 private:
  int16_t history_[TAPS] = {};
  size_t pos_ = 0;
  bool odd_ = true;
};

/** 22050 Hz in, 44.1 kHz out: two output samples per input sample. */
class Interpolator {
 public:
  void push(const int16_t sample, int16_t& first, int16_t& second) {
    constexpr size_t N = (TAPS + 1) / 2;  // input samples under the filter
    history_[pos_] = sample;
    // Newest input at k = 0: first = 2 * sum h[2k] x[n-k], second = 2 * sum h[2k+1] x[n-k].
    int32_t even = 0;
    int32_t odd = 0;
    const int16_t* h = taps();
    size_t i = pos_;
    for (size_t k = 0; k < N; ++k) {
      even += static_cast<int32_t>(h[2 * k]) * history_[i];
      if (2 * k + 1 < TAPS) odd += static_cast<int32_t>(h[2 * k + 1]) * history_[i];
      i = i == 0 ? N - 1 : i - 1;
    }
    pos_ = (pos_ + 1) % N;
    first = clamp16((even + 8192) >> 14);
    second = clamp16((odd + 8192) >> 14);
  }

 private:
  int16_t history_[(TAPS + 1) / 2] = {};
  size_t pos_ = 0;
};

}  // namespace resample2x
